/*
	avrOrganeByWaveformGenerator.c
	
	+) In this sketch, i will implement a function playTone() to create desirable note with fixed frequency by
	Timer/Counter0 8-bit.
	+) Frequency of a note is generated by toggle on compare match in CTC mode (COM0A1:0 = 1)
	+) The waveform frequency generated on OCnx pin is defined by the following equation:
				fclk_I/O
	fOCnx = --------------------------
				2 x N x (1 + OCRnx)
	N: pre-scaler factor (1, 8, 64, 1024)
	OCRnx: The register contains an value that is continuously compared with the counter value (TCNT0)
	
	+) In function main(), playing a sounding of level up and a Wah-Wah-Wah-Wah sound.
	
	Source: Nguyen Hai Nam
 */ 

#define F_CPU 12000000UL						// Clock CPU: 12MHz
#include <avr/io.h>
#include <util/delay.h>
#include "pitches.h"

/*	Define device pin	*/
#define SPEAKER_DDR				DDRD
#define SPEAKER_PORT			PORTD
#define SPEAKER_PIN				PIND
#define SPEAKER					PORTD6

/*	Function for initiating CTC mode in Timer0	*/
static inline void initTimer0(void)
{	
	// COM0A1:0 = 1 -> toggle OC0A on compare match
	// WGM02:0 = 2  -> CTC mode
	TCCR0A |= (1 << COM0A0) | (1 << WGM01);
}

/*	Choose a suitable prescaler for frequency	*/
void choosePrescaler(uint16_t frequency)
{
	initTimer0();
	
	// calculate value in Output compare Register (OCR0A)
	uint32_t ocr;												// NOTE: use uint32_t to prevent overflow
	uint8_t prescalerBits;										// store prescaler bits							
	
	ocr = (F_CPU / frequency / 2 / 1) - 1;						// calculate value in OCR0A with prescaler = 1
	prescalerBits = (1 << CS00);								// setup prescaler factor in TCCR0B
	if (ocr > 255)
	{
		ocr = (F_CPU / frequency / 2 / 8) - 1;					// calculate value in OCR0A with prescaler = 8
		prescalerBits  = (1 << CS01);
		
		if (ocr > 255)
		{
			ocr = (F_CPU / frequency / 2 / 64) - 1;				// calculate value in OCR0A with prescaler = 64
			prescalerBits  = (1 << CS00) | (1 << CS01);
			
			if (ocr > 255)
			{
				ocr = (F_CPU / frequency / 2 / 256) - 1;		// calculate value in OCR0A with prescaler = 256
				prescalerBits  = (1 << CS02);
				
				if (ocr > 255)
				{
					ocr = (F_CPU / frequency / 2 / 1024) - 1;	// calculate value in OCR0A with prescaler = 1024
					prescalerBits  = (1 << CS02) | (1 << CS00);
				}
			}
		}
	}
	
	TCCR0B = (TCCR0B & 0b11110000) | prescalerBits;
	OCR0A = ocr;	// value that is continuously compared with the counter value (TCNT0)
}

/*	Function playTone()	with frequency and duration	*/
void playTone(uint16_t frequency, uint16_t duration)
{
	choosePrescaler(frequency);						// choose prescaler fit for frequency
	SPEAKER_DDR |= (1 << SPEAKER);					// NOTE: must declare OCR0A pin (SPEAKER pin) as output
	
	while(duration)									// variable delay
	{
		_delay_ms(1);
		--duration;
	}
	
	SPEAKER_DDR &= ~(1 << SPEAKER);					// turn speaker off	
}

int main(void)
{
    /*------------Inits--------------*/
	initTimer0();
	
	/*----------Event loops--------*/
    while (1) 
    {
		/*	Playing a level up sound	*/
		playTone(NOTE_E4, 200);
		playTone(NOTE_G4, 200);
		playTone(NOTE_E5, 200);
		playTone(NOTE_C5, 200);
		playTone(NOTE_D5, 200);
		playTone(NOTE_G5, 200);
		
		
		_delay_ms(1000);
		_delay_ms(1000);
		
		/*	Play a Wah-Wah-Wah-Wah sound	*/
		playTone(NOTE_DS5, 300);
		playTone(NOTE_D5, 300);
		playTone(NOTE_CS5, 300);
		
		for (uint8_t i = 0; i < 10; i++)
		{
			for (int8_t pitch = -5; pitch < 5; pitch++)
			{
				playTone(NOTE_C5 + pitch, 10);
			}
		}
		
		_delay_ms(1000);
		_delay_ms(1000);		
    }
}

